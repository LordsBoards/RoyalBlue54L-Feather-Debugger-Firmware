## app/boards/lordsboards/royalblue54l/Kconfig.royalblue54l
```kconfig
# Copyright (c) 2024 Nordic Semiconductor ASA
# SPDX-License-Identifier: Apache-2.0

config BOARD_ROYALBLUE54L
	select SOC_NRF54L15_CPUAPP if BOARD_ROYALBLUE54L_NRF54L15_CPUAPP || BOARD_ROYALBLUE54L_NRF54L15_CPUAPP_NS
	select SOC_NRF54L15_CPUFLPR if BOARD_ROYALBLUE54L_NRF54L15_CPUFLPR || \
					    BOARD_ROYALBLUE54L_NRF54L15_CPUFLPR_XIP
```

## app/boards/lordsboards/royalblue54l/board.yml
```yaml
board:
  name: royalblue54l 
  full_name: RoyalBlue54L 
  vendor: lordsboards 
  socs:
  - name: nrf54l15
    variants:
    - name: xip
      cpucluster: cpuflpr
    - name: ns
      cpucluster: cpuapp
```

## app/boards/lordsboards/royalblue54l_debugger/Kconfig.defconfig
```kconfig
# RoyalBlue54L Debugger nRF52833 board configuration

# Copyright (c) 2024 Lord's Boards LLC
# SPDX-License-Identifier: Apache-2.0

if BOARD_ROYALBLUE54L_DEBUGGER

config BT_CTLR
	default BT

endif # BOARD_ROYALBLUE54L_DEBUGGER
```

## app/boards/lordsboards/royalblue54l_debugger/board.yml
```yaml
board:
  name: royalblue54l_debugger 
  full_name: RoyalBlue54L Debugger
  vendor: lordsboards 
  socs:
  - name: nrf52833
```

## west.yml
```yaml
# Copyright (c) 2021 Nordic Semiconductor ASA
# SPDX-License-Identifier: Apache-2.0

manifest:
  remotes:
    - name: zephyrproject-rtos
      url-base: https://github.com/zephyrproject-rtos
    - name: lordsboards
      url-base: https://github.com/LordsBoards

  projects:
    - name: zephyr
      remote: zephyrproject-rtos
      revision: main
      import:
        name-allowlist:
          - cmsis
          - hal_nordic
          - mcuboot
    - name: royalblue-nrf54l15-zephyr-boards
      remote: lordsboards
      repo-path: RoyalBlue-nRF54L15-Zephyr-Boards
      path: modules/boards/royalblue-nrf54l15-zephyr-boards
      revision: main
```
